## CMakeLists.txt
```
cmake_minimum_required(VERSION 3.20.0)

find_package(Zephyr)
project(uart-hello)

target_sources(app PRIVATE src/main.c)
```

## prj.conf
```kconfig
# Scenario 01 / "Bao + Zephyr + UART" - minimal printk app.
#
# Explicitly disable PLIC: the cv32a6 SoC's Kconfig.defconfig sets
# `config PLIC default y` and `select RISCV_HAS_PLIC`, but our baovm board
# uses APLIC + IMSIC (no PLIC node in DT). Without this override, the
# PLIC driver tries to compile against a non-existent DT instance and
# build fails.
CONFIG_PLIC=n
```

## src/main.c
```c
/*
 * SPDX-License-Identifier: Apache-2.0
 *
 * Workshop scenario 01 / Bao + Zephyr smoke test.
 *
 * Prints a banner once Zephyr is up, then idles. The purpose is just to
 * confirm Zephyr boots as a Bao guest with UART output reaching the
 * console; no shell, no IPC.
 */

#include <stdio.h>
#include <zephyr/kernel.h>

int main(void)
{
	printk("Hello from Zephyr (workshop guest, board %s)\n",
	       CONFIG_BOARD_TARGET);
	return 0;
}
```
