## guests/zephyr/boards/riscv/baovm_qemu-virt-spmp/board.yml
```yaml
board:
  name: baovm_qemu-virt-spmp
  full_name: Bao guest on QEMU virt (SPMP)
  vendor: osyx
  socs:
    - name: cv32a6
```

## guests/zephyr/boards/riscv/qemu-virt-spmp/board.yml
```yaml
board:
  name: qemu-virt-spmp
  full_name: Standalone Zephyr on QEMU virt (SPMP)
  vendor: osyx
  socs:
    - name: cv32a6
```

## guests/zephyr/zephyr/drivers/virtualization/Kconfig
```kconfig
# Virtualization drivers configuration options

# Copyright (c) 2015-2020 Intel Corporation
# SPDX-License-Identifier: Apache-2.0

menuconfig VIRTUALIZATION
	bool "Virtualization guest drivers"
	help
	  This contains various drivers meant to support and expose features
	  when Zephyr is running as a guest in a virtualized or emulated
	  environment.

if VIRTUALIZATION

config BAO_IPCSHMEM
	bool "Bao IPC shared memory driver"
	help
	  Support for the Bao hypervisor's inter-VM shared memory channel.
	  Two guests are each mapped to a shmem region (carved by the
	  hypervisor) and signal each other via an interrupt provisioned by
	  Bao. Useful for lightweight VM-to-VM messaging.

if BAO_IPCSHMEM

config BAO_IPCSHMEM_SHELL
	bool "Bao IPC shared memory shell module"
	depends on SHELL
	select DYNAMIC_INTERRUPTS
	help
	  Interactive shell commands that exercise the Bao IPC shared
	  memory driver (read / write / notify the peer guest). Handy as
	  the workshop demo entry point.

endif # BAO_IPCSHMEM

config IVSHMEM
	bool "Inter-VM shared memory device (ivshmem)"
	depends on PCIE
	help
	  This will enable support of qemu's ivshmem device, which is also
	  present in ACRN hypervisor, and lets VM sharing memory with each
	  other.

if IVSHMEM

module = IVSHMEM
module-str = ivshmem
source "subsys/logging/Kconfig.template.log_config"

config IVSHMEM_DOORBELL
	bool "Support interrupt based ivshmem (doorbell version)"
	help
	  This will enable support of ivshmem-doorbell, i.e. the interrupt
	  based ivshmem. For ivshmem-v2 INTx interrupts are also supported.

config IVSHMEM_MSI_X_VECTORS
	int "How many notification vectors should be pre-allocated?"
	default 2
	depends on IVSHMEM_DOORBELL
	help
	  MSI-X vector holders must be pre-allocated. One can pre-allocate
	  more or less than necessary. Depends on how many VMs will connect
	  with each other. These are know to be the notification vectors in
	  ivshmem.

config IVSHMEM_INT_PRIORITY
	int "MSI-X interrupt priority"
	default 2
	depends on IVSHMEM_DOORBELL
	help
	  Interrupt priority used for the MSI-X generated interrupts.
	  INTx interrupt priority is configured in the device tree.

config IVSHMEM_SHELL
	bool "IVshmem shell module"
	depends on SHELL
	help
	  This is mostly a module to help getting info the ivshmem and/or
	  quickly testing your ivshmem client application (from another VM).

endif # IVSHMEM

config IVSHMEM_V2
	bool "Inter-VM shared memory v2 (ivshmem-v2)"
	select IVSHMEM
	help
	  Enable ivshmem-v2 support.
	  ivshmem-v2 is primarily used for IPC in the Jailhouse hypervisor.

config IVSHMEM_V2_MAX_PEERS
	int "Maximum number of ivshmem-v2 peers"
	depends on IVSHMEM_V2
	default 2
	range 2 65536

endif # VIRTUALIZATION
```

## guests/zephyr/zephyr/dts/bindings/virtualization/bao,ipcshmem.yaml
```yaml
description: Bao IPC Shared Memory

compatible: "bao,ipcshmem"

include: base.yaml

properties:
  reg:
    required: true
  read-channel:
    type: array
  write-channel:
    type: array
  id:
    type: int
  zephyr,memory-region:
   type: string
  zephyr,memory-attr:
   type: int
```

## opensbi/platform/fpga/ariane/configs/defconfig
```kconfig
CONFIG_FDT_IPI=y
CONFIG_FDT_IPI_MSWI=y
CONFIG_FDT_IRQCHIP=y
CONFIG_FDT_IRQCHIP_APLIC=y
CONFIG_FDT_IRQCHIP_IMSIC=y
CONFIG_FDT_IRQCHIP_PLIC=y
```
